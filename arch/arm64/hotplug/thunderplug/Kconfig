## arch/arm64/hotplug/thunderplug/Kconfig
```kconfig
config THUNDERPLUG_HOTPLUG
	bool "Enable plugging down/up of cores using powersuspend"
	help
	  This driver uses powersuspend to take down the cpu cores
	  on a octa core device.
```
